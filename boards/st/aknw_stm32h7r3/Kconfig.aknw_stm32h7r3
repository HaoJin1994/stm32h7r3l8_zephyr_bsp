## hello_world/modules/led/Kconfig
```kconfig
config MODULE_LED
    bool "Enable LED support"
    default n
    depends on GPIO
```

## hello_world/modules/net/Kconfig
```kconfig
config MODULE_ETH
    bool "Enable Ethernet module"
    default n
    depends on CONFIG_NET_IPV4 && CONFIG_NETWORKING
    help
        Enable Ethernet module.
```

## hello_world/modules/pwm/Kconfig
```kconfig
config MODULE_PWM
    bool "Enable PWM support"
    default n
    help
        PWM support is required for PWM devices.




        
```

## hello_world/modules/sensor/Kconfig
```kconfig
config MODULE_SENSOR
    bool "Enable sensor module"
    default n
    depends on SENSOR && W1
    help
    Enable sensor module
```

## hello_world/modules/spi_flash/Kconfig
```kconfig
config MODULE_SPI_FLASH
    bool "Enable SPI flash support"
    default n
    depends on SPI_NOR
    help
        SPI flash support is required for SPI flash devices.
```
