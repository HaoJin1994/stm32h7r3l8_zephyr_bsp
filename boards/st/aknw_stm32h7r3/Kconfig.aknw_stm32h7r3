## boards/st/aknw_stm32h7r3/Kconfig.aknw_stm32h7r3
```kconfig
# Copyright (c) 2024 STMicroelectronics
# SPDX-License-Identifier: Apache-2.0

config BOARD_AKNW_STM32H7R3
	select SOC_STM32H7R3XX
```

## boards/st/aknw_stm32h7r3/Kconfig.defconfig
```kconfig
# STM32H7S3L8 NUCLEO board configuration
#
# Copyright (c) 2024 STMicroelectronics
#
# SPDX-License-Identifier: Apache-2.0

if BOARD_AKNW_STM32H7R3

configdefault ETH_DRIVER
	default y

endif # BOARD_AKNW_STM32H7R3
```

## boards/st/aknw_stm32h7r3/Kconfig.sysbuild
```kconfig
# Copyright (c) 2024-2025 STMicroelectronics
# Copyright (c) 2025 JB-Lighting Lichtanlagentechnik
# SPDX-License-Identifier: Apache-2.0

if BOARD_AKNW_STM32H7R3_STM32H7R3XX_EXT_FLASH_APP

choice BOOTLOADER
	default BOOTLOADER_MCUBOOT
endchoice

choice BOOT_SIGNATURE_TYPE
	default BOOT_SIGNATURE_TYPE_NONE
endchoice

endif # BOARD_AKNW_STM32H7R3_STM32H7R3XX_EXT_FLASH_APP
```

## boards/st/aknw_stm32h7r3/board.yml
```yaml
board:
  name: aknw_stm32h7r3
  full_name: STM32H7R3 AKNW
  vendor: st
  socs:
    - name: stm32h7r3xx
      variants:
        - name: ext_flash_app
```

## hello_world/build/Kconfig/arch/Kconfig
```kconfig
# Load Zephyr Arch Kconfig descriptions.
osource "/home/ubuntu/work/zephyr/zephyr/arch/hexagon/Kconfig"
osource "/home/ubuntu/work/zephyr/zephyr/arch/rx/Kconfig"
osource "/home/ubuntu/work/zephyr/zephyr/arch/x86/Kconfig"
osource "/home/ubuntu/work/zephyr/zephyr/arch/xtensa/Kconfig"
osource "/home/ubuntu/work/zephyr/zephyr/arch/sparc/Kconfig"
osource "/home/ubuntu/work/zephyr/zephyr/arch/riscv/Kconfig"
osource "/home/ubuntu/work/zephyr/zephyr/arch/posix/Kconfig"
osource "/home/ubuntu/work/zephyr/zephyr/arch/openrisc/Kconfig"
osource "/home/ubuntu/work/zephyr/zephyr/arch/mips/Kconfig"
osource "/home/ubuntu/work/zephyr/zephyr/arch/arm64/Kconfig"
osource "/home/ubuntu/work/zephyr/zephyr/arch/arm/Kconfig"
osource "/home/ubuntu/work/zephyr/zephyr/arch/arc/Kconfig"
```

## hello_world/build/mcuboot/Kconfig/Kconfig.modules
```kconfig
menu "acpica (/home/ubuntu/work/zephyr/modules/lib/acpica)"
osource "$(ZEPHYR_ACPICA_KCONFIG)"
config ZEPHYR_ACPICA_MODULE
	bool
	default y
endmenu
menu "cmsis (/home/ubuntu/work/zephyr/modules/hal/cmsis)"
osource "$(ZEPHYR_CMSIS_KCONFIG)"
config ZEPHYR_CMSIS_MODULE
	bool
	default y
endmenu
menu "cmsis-dsp (/home/ubuntu/work/zephyr/modules/lib/cmsis-dsp)"
osource "/home/ubuntu/work/zephyr/modules/lib/cmsis-dsp/zephyr/Kconfig"
config ZEPHYR_CMSIS_DSP_MODULE
	bool
	default y
endmenu
menu "cmsis-nn (/home/ubuntu/work/zephyr/modules/lib/cmsis-nn)"
osource "$(ZEPHYR_CMSIS_NN_KCONFIG)"
config ZEPHYR_CMSIS_NN_MODULE
	bool
	default y
endmenu
menu "cmsis_6 (/home/ubuntu/work/zephyr/modules/hal/cmsis_6)"
osource "$(ZEPHYR_CMSIS_6_KCONFIG)"
config ZEPHYR_CMSIS_6_MODULE
	bool
	default y
endmenu
menu "dhara (/home/ubuntu/work/zephyr/modules/lib/dhara)"
osource "$(ZEPHYR_DHARA_KCONFIG)"
config ZEPHYR_DHARA_MODULE
	bool
	default y
endmenu
menu "fatfs (/home/ubuntu/work/zephyr/modules/fs/fatfs)"
osource "$(ZEPHYR_FATFS_KCONFIG)"
config ZEPHYR_FATFS_MODULE
	bool
	default y
endmenu
config ZEPHYR_ADI_MODULE
	bool
	default y
menu "hal_afbr (/home/ubuntu/work/zephyr/modules/hal/afbr)"
osource "$(ZEPHYR_HAL_AFBR_KCONFIG)"
config ZEPHYR_HAL_AFBR_MODULE
	bool
	default y

config ZEPHYR_HAL_AFBR_MODULE_BLOBS
	bool
endmenu
menu "hal_ambiq (/home/ubuntu/work/zephyr/modules/hal/ambiq)"
osource "$(ZEPHYR_HAL_AMBIQ_KCONFIG)"
config ZEPHYR_HAL_AMBIQ_MODULE
	bool
	default y
endmenu
config ZEPHYR_ATMEL_MODULE
	bool
	default y
menu "hal_bouffalolab (/home/ubuntu/work/zephyr/modules/hal/bouffalolab)"
osource "$(ZEPHYR_HAL_BOUFFALOLAB_KCONFIG)"
config ZEPHYR_HAL_BOUFFALOLAB_MODULE
	bool
	default y

config ZEPHYR_HAL_BOUFFALOLAB_MODULE_BLOBS
	bool
endmenu
menu "hal_ethos_u (/home/ubuntu/work/zephyr/modules/hal/ethos_u)"
osource "$(ZEPHYR_HAL_ETHOS_U_KCONFIG)"
config ZEPHYR_HAL_ETHOS_U_MODULE
	bool
	default y
endmenu
menu "hal_gigadevice (/home/ubuntu/work/zephyr/modules/hal/gigadevice)"
osource "$(ZEPHYR_HAL_GIGADEVICE_KCONFIG)"
config ZEPHYR_HAL_GIGADEVICE_MODULE
	bool
	default y
endmenu
menu "hal_infineon (/home/ubuntu/work/zephyr/modules/hal/infineon)"
osource "$(ZEPHYR_HAL_INFINEON_KCONFIG)"
config ZEPHYR_HAL_INFINEON_MODULE
	bool
	default y

config ZEPHYR_HAL_INFINEON_MODULE_BLOBS
	bool
endmenu
menu "hal_intel (/home/ubuntu/work/zephyr/modules/hal/intel)"
osource "/home/ubuntu/work/zephyr/modules/hal/intel/zephyr/Kconfig"
config ZEPHYR_HAL_INTEL_MODULE
	bool
	default y
endmenu
config ZEPHYR_HAL_MICROCHIP_MODULE
	bool
	default y

config ZEPHYR_HAL_MICROCHIP_MODULE_BLOBS
	bool
config ZEPHYR_NUVOTON_MODULE
	bool
	default y
menu "hal_nxp (/home/ubuntu/work/zephyr/modules/hal/nxp)"
osource "$(ZEPHYR_HAL_NXP_KCONFIG)"
config ZEPHYR_HAL_NXP_MODULE
	bool
	default y

config ZEPHYR_HAL_NXP_MODULE_BLOBS
	bool
endmenu
config ZEPHYR_OPENISA_MODULE
	bool
	default y
config ZEPHYR_HAL_STM32_MODULE
	bool
	default y

config ZEPHYR_HAL_STM32_MODULE_BLOBS
	bool
menu "littlefs (/home/ubuntu/work/zephyr/modules/fs/littlefs)"
osource "$(ZEPHYR_LITTLEFS_KCONFIG)"
config ZEPHYR_LITTLEFS_MODULE
	bool
	default y
endmenu
config ZEPHYR_MCUBOOT_MODULE
	bool
	default y
menu "zcbor (/home/ubuntu/work/zephyr/modules/lib/zcbor)"
osource "$(ZEPHYR_ZCBOR_KCONFIG)"
config ZEPHYR_ZCBOR_MODULE
	bool
	default y
endmenu
```

## hello_world/build/mcuboot/Kconfig/boards/Kconfig.defconfig
```kconfig
# Load Zephyr board defconfig descriptions.
osource "/home/ubuntu/work/aknw_h7rsx/boards/st/aknw_stm32h7r3/Kconfig.defconfig"
```

## hello_world/build/mcuboot/Kconfig/boards/Kconfig.sysbuild
```kconfig
# Load Sysbuild board Kconfig descriptions.
osource "/home/ubuntu/work/aknw_h7rsx/boards/st/aknw_stm32h7r3/Kconfig.sysbuild"
```

## hello_world/build/mcuboot/Kconfig/soc/Kconfig
```kconfig
# Load Zephyr SoC Kconfig descriptions.
osource "/home/ubuntu/work/zephyr/zephyr/soc/xlnx/zynqmp/Kconfig"
osource "/home/ubuntu/work/zephyr/zephyr/soc/xlnx/zynq7000/Kconfig"
osource "/home/ubuntu/work/zephyr/zephyr/soc/xlnx/versalnet/Kconfig"
osource "/home/ubuntu/work/zephyr/zephyr/soc/xlnx/versal2/Kconfig"
osource "/home/ubuntu/work/zephyr/zephyr/soc/xlnx/versal/Kconfig"
osource "/home/ubuntu/work/zephyr/zephyr/soc/xen/Kconfig"
osource "/home/ubuntu/work/zephyr/zephyr/soc/wch/ch32v/Kconfig"
osource "/home/ubuntu/work/zephyr/zephyr/soc/ti/tiva_c/Kconfig"
osource "/home/ubuntu/work/zephyr/zephyr/soc/ti/simplelink/Kconfig"
osource "/home/ubuntu/work/zephyr/zephyr/soc/ti/mspm/Kconfig"
osource "/home/ubuntu/work/zephyr/zephyr/soc/ti/lm3s6965/Kconfig"
osource "/home/ubuntu/work/zephyr/zephyr/soc/ti/k3/Kconfig"
osource "/home/ubuntu/work/zephyr/zephyr/soc/ti/am13/Kconfig"
osource "/home/ubuntu/work/zephyr/zephyr/soc/telink/tlsr/Kconfig"
osource "/home/ubuntu/work/zephyr/zephyr/soc/syna/sr100/Kconfig"
osource "/home/ubuntu/work/zephyr/zephyr/soc/starfive/jh71xx/Kconfig"
osource "/home/ubuntu/work/zephyr/zephyr/soc/st/stm32/Kconfig"
osource "/home/ubuntu/work/zephyr/zephyr/soc/snps/qemu_arc/Kconfig"
osource "/home/ubuntu/work/zephyr/zephyr/soc/snps/nsim/arc_v/Kconfig"
osource "/home/ubuntu/work/zephyr/zephyr/soc/snps/nsim/arc_classic/Kconfig"
osource "/home/ubuntu/work/zephyr/zephyr/soc/snps/hsdk4xd/Kconfig"
osource "/home/ubuntu/work/zephyr/zephyr/soc/snps/hsdk/Kconfig"
osource "/home/ubuntu/work/zephyr/zephyr/soc/snps/emsk/Kconfig"
osource "/home/ubuntu/work/zephyr/zephyr/soc/snps/emsdp/Kconfig"
osource "/home/ubuntu/work/zephyr/zephyr/soc/snps/arc_iot/Kconfig"
osource "/home/ubuntu/work/zephyr/zephyr/soc/silabs/Kconfig"
osource "/home/ubuntu/work/zephyr/zephyr/soc/sifli/sf32/Kconfig"
osource "/home/ubuntu/work/zephyr/zephyr/soc/sifive/sifive_freedom/Kconfig"
osource "/home/ubuntu/work/zephyr/zephyr/soc/shakti/Kconfig"
osource "/home/ubuntu/work/zephyr/zephyr/soc/sensry/Kconfig"
osource "/home/ubuntu/work/zephyr/zephyr/soc/rockchip/Kconfig"
osource "/home/ubuntu/work/zephyr/zephyr/soc/renode/riscv_virtual/Kconfig"
osource "/home/ubuntu/work/zephyr/zephyr/soc/renode/cortex_r8_virtual/Kconfig"
osource "/home/ubuntu/work/zephyr/zephyr/soc/renesas/smartbond/Kconfig"
osource "/home/ubuntu/work/zephyr/zephyr/soc/renesas/rz/Kconfig"
osource "/home/ubuntu/work/zephyr/zephyr/soc/renesas/rx/Kconfig"
osource "/home/ubuntu/work/zephyr/zephyr/soc/renesas/rcar/Kconfig"
osource "/home/ubuntu/work/zephyr/zephyr/soc/renesas/ra/Kconfig"
osource "/home/ubuntu/work/zephyr/zephyr/soc/realtek/fingerprint/Kconfig"
osource "/home/ubuntu/work/zephyr/zephyr/soc/realtek/ec/Kconfig"
osource "/home/ubuntu/work/zephyr/zephyr/soc/realtek/bee/Kconfig"
osource "/home/ubuntu/work/zephyr/zephyr/soc/realtek/ameba/Kconfig"
osource "/home/ubuntu/work/zephyr/zephyr/soc/raspberrypi/rpi_pico/Kconfig"
osource "/home/ubuntu/work/zephyr/zephyr/soc/quicklogic/eos_s3/Kconfig"
osource "/home/ubuntu/work/zephyr/zephyr/soc/qemu/virt_riscv/Kconfig"
osource "/home/ubuntu/work/zephyr/zephyr/soc/qemu/or1k/Kconfig"
osource "/home/ubuntu/work/zephyr/zephyr/soc/qemu/malta/Kconfig"
osource "/home/ubuntu/work/zephyr/zephyr/soc/qemu/hexagon/Kconfig"
osource "/home/ubuntu/work/zephyr/zephyr/soc/openisa/rv32m1/Kconfig"
osource "/home/ubuntu/work/zephyr/zephyr/soc/openhwgroup/cva6/Kconfig"
osource "/home/ubuntu/work/zephyr/zephyr/soc/oct/osd32mp15x/Kconfig"
osource "/home/ubuntu/work/zephyr/zephyr/soc/nxp/s32/Kconfig"
osource "/home/ubuntu/work/zephyr/zephyr/soc/nxp/rw/Kconfig"
osource "/home/ubuntu/work/zephyr/zephyr/soc/nxp/mcx/Kconfig"
osource "/home/ubuntu/work/zephyr/zephyr/soc/nxp/lpc/Kconfig"
osource "/home/ubuntu/work/zephyr/zephyr/soc/nxp/layerscape/Kconfig"
osource "/home/ubuntu/work/zephyr/zephyr/soc/nxp/kinetis/Kconfig"
osource "/home/ubuntu/work/zephyr/zephyr/soc/nxp/imxrt/Kconfig"
osource "/home/ubuntu/work/zephyr/zephyr/soc/nxp/imx/Kconfig"
osource "/home/ubuntu/work/zephyr/zephyr/soc/nuvoton/numicro/Kconfig"
osource "/home/ubuntu/work/zephyr/zephyr/soc/nuvoton/numaker/Kconfig"
osource "/home/ubuntu/work/zephyr/zephyr/soc/nuvoton/npcx/Kconfig"
osource "/home/ubuntu/work/zephyr/zephyr/soc/nuvoton/npcm/Kconfig"
osource "/home/ubuntu/work/zephyr/zephyr/soc/nordic/Kconfig"
osource "/home/ubuntu/work/zephyr/zephyr/soc/neorv32/Kconfig"
osource "/home/ubuntu/work/zephyr/zephyr/soc/native/inf_clock/Kconfig"
osource "/home/ubuntu/work/zephyr/zephyr/soc/microchip/smartfusion2/Kconfig"
osource "/home/ubuntu/work/zephyr/zephyr/soc/microchip/sam/sama7/Kconfig"
osource "/home/ubuntu/work/zephyr/zephyr/soc/microchip/sam/sama5/Kconfig"
osource "/home/ubuntu/work/zephyr/zephyr/soc/microchip/sam/sam_d5x_e5x/Kconfig"
osource "/home/ubuntu/work/zephyr/zephyr/soc/microchip/pic64/Kconfig"
osource "/home/ubuntu/work/zephyr/zephyr/soc/microchip/pic32c/pic32cz_ca/Kconfig"
osource "/home/ubuntu/work/zephyr/zephyr/soc/microchip/pic32c/pic32cx_sg/Kconfig"
osource "/home/ubuntu/work/zephyr/zephyr/soc/microchip/pic32c/pic32cm_sg_gc/Kconfig"
osource "/home/ubuntu/work/zephyr/zephyr/soc/microchip/pic32c/pic32cm_pl/Kconfig"
osource "/home/ubuntu/work/zephyr/zephyr/soc/microchip/pic32c/pic32cm_jh/Kconfig"
osource "/home/ubuntu/work/zephyr/zephyr/soc/microchip/pic32c/pic32ck_sg_gc/Kconfig"
osource "/home/ubuntu/work/zephyr/zephyr/soc/microchip/miv/Kconfig"
osource "/home/ubuntu/work/zephyr/zephyr/soc/microchip/mec/Kconfig"
osource "/home/ubuntu/work/zephyr/zephyr/soc/mediatek/mt8xxx/Kconfig"
osource "/home/ubuntu/work/zephyr/zephyr/soc/lowrisc/opentitan/Kconfig"
osource "/home/ubuntu/work/zephyr/zephyr/soc/litex/Kconfig"
osource "/home/ubuntu/work/zephyr/zephyr/soc/ite/ec/Kconfig"
osource "/home/ubuntu/work/zephyr/zephyr/soc/intel/wildcat_lake/Kconfig"
osource "/home/ubuntu/work/zephyr/zephyr/soc/intel/raptor_lake/Kconfig"
osource "/home/ubuntu/work/zephyr/zephyr/soc/intel/panther_lake/Kconfig"
osource "/home/ubuntu/work/zephyr/zephyr/soc/intel/nova_lake/Kconfig"
osource "/home/ubuntu/work/zephyr/zephyr/soc/intel/lakemont/Kconfig"
osource "/home/ubuntu/work/zephyr/zephyr/soc/intel/intel_socfpga_std/Kconfig"
osource "/home/ubuntu/work/zephyr/zephyr/soc/intel/intel_socfpga/Kconfig"
osource "/home/ubuntu/work/zephyr/zephyr/soc/intel/intel_niosv/Kconfig"
osource "/home/ubuntu/work/zephyr/zephyr/soc/intel/intel_ish/Kconfig"
osource "/home/ubuntu/work/zephyr/zephyr/soc/intel/intel_adsp/Kconfig"
osource "/home/ubuntu/work/zephyr/zephyr/soc/intel/elkhart_lake/Kconfig"
osource "/home/ubuntu/work/zephyr/zephyr/soc/intel/atom/Kconfig"
osource "/home/ubuntu/work/zephyr/zephyr/soc/intel/apollo_lake/Kconfig"
osource "/home/ubuntu/work/zephyr/zephyr/soc/intel/alder_lake/Kconfig"
osource "/home/ubuntu/work/zephyr/zephyr/soc/infineon/psoc4/Kconfig"
osource "/home/ubuntu/work/zephyr/zephyr/soc/infineon/edge/Kconfig"
osource "/home/ubuntu/work/zephyr/zephyr/soc/infineon/cat3/Kconfig"
osource "/home/ubuntu/work/zephyr/zephyr/soc/infineon/cat1c/Kconfig"
osource "/home/ubuntu/work/zephyr/zephyr/soc/infineon/cat1b/Kconfig"
osource "/home/ubuntu/work/zephyr/zephyr/soc/infineon/cat1a/Kconfig"
osource "/home/ubuntu/work/zephyr/zephyr/soc/gd/gd32/Kconfig"
osource "/home/ubuntu/work/zephyr/zephyr/soc/gaisler/leon3/Kconfig"
osource "/home/ubuntu/work/zephyr/zephyr/soc/gaisler/gr716a/Kconfig"
osource "/home/ubuntu/work/zephyr/zephyr/soc/focaltech/Kconfig"
osource "/home/ubuntu/work/zephyr/zephyr/soc/espressif/Kconfig"
osource "/home/ubuntu/work/zephyr/zephyr/soc/ene/kb1200/Kconfig"
osource "/home/ubuntu/work/zephyr/zephyr/soc/ene/kb106x/Kconfig"
osource "/home/ubuntu/work/zephyr/zephyr/soc/elan/em32f967/Kconfig"
osource "/home/ubuntu/work/zephyr/zephyr/soc/egis/Kconfig"
osource "/home/ubuntu/work/zephyr/zephyr/soc/efinix/sapphire/Kconfig"
osource "/home/ubuntu/work/zephyr/zephyr/soc/cdns/xtensa_sample_controller/Kconfig"
osource "/home/ubuntu/work/zephyr/zephyr/soc/cdns/swerv/Kconfig"
osource "/home/ubuntu/work/zephyr/zephyr/soc/cdns/sample_controller32/Kconfig"
osource "/home/ubuntu/work/zephyr/zephyr/soc/cdns/dc233c/Kconfig"
osource "/home/ubuntu/work/zephyr/zephyr/soc/brcm/bcmvk/Kconfig"
osource "/home/ubuntu/work/zephyr/zephyr/soc/brcm/bcm2712/Kconfig"
osource "/home/ubuntu/work/zephyr/zephyr/soc/brcm/bcm2711/Kconfig"
osource "/home/ubuntu/work/zephyr/zephyr/soc/brcm/bcm2710/Kconfig"
osource "/home/ubuntu/work/zephyr/zephyr/soc/blackberry/qnxhv_vm/Kconfig"
osource "/home/ubuntu/work/zephyr/zephyr/soc/bflb/Kconfig"
osource "/home/ubuntu/work/zephyr/zephyr/soc/atmel/sam0/Kconfig"
osource "/home/ubuntu/work/zephyr/zephyr/soc/atmel/sam/Kconfig"
osource "/home/ubuntu/work/zephyr/zephyr/soc/aspeed/Kconfig"
osource "/home/ubuntu/work/zephyr/zephyr/soc/arm/Kconfig"
osource "/home/ubuntu/work/zephyr/zephyr/soc/antmicro/myra/Kconfig"
osource "/home/ubuntu/work/zephyr/zephyr/soc/andestech/Kconfig"
osource "/home/ubuntu/work/zephyr/zephyr/soc/amd/acp_7_x/Kconfig"
osource "/home/ubuntu/work/zephyr/zephyr/soc/amd/acp_7_0/Kconfig"
osource "/home/ubuntu/work/zephyr/zephyr/soc/amd/acp_6_0/Kconfig"
osource "/home/ubuntu/work/zephyr/zephyr/soc/ambiq/Kconfig"
osource "/home/ubuntu/work/zephyr/zephyr/soc/allwinner/sun8i_h3/Kconfig"
osource "/home/ubuntu/work/zephyr/zephyr/soc/allwinner/sun50i_h618/Kconfig"
osource "/home/ubuntu/work/zephyr/zephyr/soc/alif/ensemble/Kconfig"
osource "/home/ubuntu/work/zephyr/zephyr/soc/alif/balletto/Kconfig"
osource "/home/ubuntu/work/zephyr/zephyr/soc/aesc/Kconfig"
osource "/home/ubuntu/work/zephyr/zephyr/soc/adi/max32/Kconfig"
```

## hello_world/modules/adc/Kconfig
```kconfig
config MODULE_ADC
    bool "ADC Module"
    default n
    depends on ADC
    help
        ADC module for Zephyr
```

## hello_world/modules/cdc_acm/Kconfig
```kconfig
config MODULE_CDC_ACM
    bool "Enable CDC ACM device support"
    default n
    depends on USB_DEVICE_STACK && USB_CDC_ACM && UART_LINE_CTRL
```

## hello_world/modules/dac/Kconfig
```kconfig
config MODULE_DAC
    bool "Enable DAC device support"
    default n
    depends on DAC
```

## hello_world/modules/eeprom/Kconfig
```kconfig
config MODULE_EEPROM
	bool "I2C EEPROM Module"
	default n
    depends on I2C && EEPROM_AT24
```
