/ {
    fstab {
        compatible = "zephyr,fstab";
        lfs1: lfs1 {
            compatible = "zephyr,fstab,littlefs";
            mount-point = "/lfs";
            partition = <&storage_partition>;
            read-size = <16>; //读操作的最小单位
            prog-size = <16>; //写操作的最小单位
            cache-size = <64>; //缓存大小
            lookahead-size = <32>; //分配扫描缓冲区大小
            block-cycles = <512>; //最大块周期数
            automount;
        };
    };
};





