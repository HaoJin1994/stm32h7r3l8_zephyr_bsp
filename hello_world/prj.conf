## CMakeLists.txt
```
# SPDX-License-Identifier: Apache-2.0

cmake_minimum_required(VERSION 3.28.0)

find_package(Zephyr REQUIRED HINTS $ENV{ZEPHYR_BASE})
project(hello_world)

target_sources(app PRIVATE 
    src/main.c
    #src/flash_rw.c
    #src/sha256.c
)

if(CONFIG_MODULE_SENSOR)
target_sources(app PRIVATE 
    src/shell_sensor_cmd.c
)
endif()
if(CONFIG_MODULE_PWM)
target_sources(app PRIVATE 
    src/shell_pwm_led_cmd.c
)
endif()
if(CONFIG_MODULE_LED)
target_sources(app PRIVATE 
    src/shell_led_cmd.c
)
endif()

target_include_directories(app PRIVATE
    include
)
```

## Kconfig
```
# 应用根目录的 Kconfig
mainmenu "My Application Configuration"

rsource "modules/led/Kconfig"
#rsource "modules/cdc_acm/Kconfig"
rsource "modules/pwm/Kconfig"
#rsource "modules/spi_flash/Kconfig"
#rsource "modules/eeprom/Kconfig"
#rsource "modules/adc/Kconfig"
#rsource "modules/dac/Kconfig"
rsource "modules/net/Kconfig"
#rsource "modules/sensor/Kconfig"

source "Kconfig.zephyr"
```

## sysbuild.conf
```
SB_CONFIG_BOOTLOADER_MCUBOOT=y
SB_CONFIG_BOOT_SIGNATURE_TYPE_ECDSA_P256=y
SB_CONFIG_BOOT_SIGNATURE_KEY_FILE="/home/ubuntu/work/aknw_h7rsx/hello_world/signing-key.pem"  # 改用相对 workspace 根目录的路径

#SB_CONFIG_MCUBOOT_MODE_SWAP_SCRATCH=y
#SB_CONFIG_MCUBOOT_MODE_SWAP_USING_MOVE=y
#SB_CONFIG_MCUBOOT_MODE_SWAP_USING_OFFSET=y
#SB_CONFIG_MCUBOOT_MODE_SINGLE_APP=y
#SB_CONFIG_MCUBOOT_MODE_DIRECT_XIP=y
SB_CONFIG_MCUBOOT_MODE_RAM_LOAD=y
```

## prj.conf
```kconfig
# 基础外设与 Shell
CONFIG_GPIO=y
CONFIG_SERIAL=y
CONFIG_UART_INTERRUPT_DRIVEN=y
CONFIG_CONSOLE=y
CONFIG_UART_CONSOLE=y
CONFIG_SHELL=y
CONFIG_SHELL_BACKEND_SERIAL=y
CONFIG_PRINTK=y

# Flash 存储驱动（供 Shell 测试外部 Flash）
CONFIG_FLASH=y
CONFIG_FLASH_MAP=y
CONFIG_FLASH_PAGE_LAYOUT=y
CONFIG_FLASH_STM32_XSPI=y

CONFIG_FLASH_JESD216_API=y
CONFIG_FLASH_LOG_LEVEL_DBG=y
```

## app.overlay
```dts
/ {

    sram_app: memory@24010000 {
        compatible = "zephyr,memory-region";
        reg = <0x24010000 DT_SIZE_K(384)>; //456KB - 64KB = 384KB
        zephyr,memory-region = "SRAM_APP";
    };


    chosen {
        zephyr,sram = &sram_app;
    };
};
```

## src/main.c
```c
#include <zephyr/kernel.h>
#include <zephyr/logging/log.h>
#include <zephyr/drivers/uart.h>
#include <zephyr/shell/shell.h>
#include <zephyr/sys/printk.h>
#include <zephyr/drivers/gpio.h>
#include <zephyr/drivers/flash.h>
#include "main.h"

LOG_MODULE_REGISTER(main,LOG_LEVEL_DBG);

#define SLEEP_TIME_MS   2000

#ifdef CONFIG_MODULE_LED
#define LED0_NODE DT_ALIAS(led1)
static const struct gpio_dt_spec led = GPIO_DT_SPEC_GET(LED0_NODE, gpios);
#endif

#define SPI_FLASH_COMPAT jedec_spi_nor



int main(void)
{

    k_msleep(SLEEP_TIME_MS);
    printk("Application started\n");
  
    printk("UART interrupt mode enabled\n");


    //littlefs_example();
    //flash_test();
    //k_msleep(SLEEP_TIME_MS);
    //print_thread_stats();
#ifdef CONFIG_MODULE_LED
    if(!gpio_is_ready_dt(&led)){
        printk("gpio is not ready\n");
        return -1;
    }
    int ret = gpio_pin_configure_dt(&led,GPIO_OUTPUT_ACTIVE);
    if(ret < 0){
        printk("Failed to configure LED\n");
        return ret;
    }
#endif


#if 0
 
    char data[32] = {0};

    const struct device *flash_dev = DEVICE_DT_GET_ONE(SPI_FLASH_COMPAT);
    if(!device_is_ready(flash_dev)){
        printk("SPI flash device is not ready\n");
        return -1;
    }
    printk("SPI flash device is ready\n");
    int rc = flash_erase(flash_dev,0x0,0x1000);
    if(rc < 0){
        printk("Failed to erase flash\n");
        return rc;
    }
    rc = flash_write(flash_dev,0x0,&"hello world",12);
    if(rc < 0){
        printk("Failed to write flash\n");
        return rc;
    }
    printk("Flash write success\n");
    rc = flash_read(flash_dev,0x0,data,12);
    if(rc < 0){
        printk("Failed to read flash\n");
        return rc;
    }
    printk("Read data: %s\n",data);

#endif

    while(1){
        //闪烁LED
#ifdef CONFIG_MODULE_LED
        gpio_pin_toggle_dt(&led);
#endif
        k_msleep(SLEEP_TIME_MS);
    }
    return 0;

}
```

## include/sha256.h
```c
/*
 * Minimal self-contained SHA-256 (no crypto library dependency).
 * SPDX-License-Identifier: Apache-2.0
 */

#ifndef OTA_SHA256_H
#define OTA_SHA256_H

#include <stdint.h>
#include <stddef.h>

#define SHA256_DIGEST_SIZE 32

struct sha256_ctx {
	uint32_t state[8];
	uint64_t count;		/* total bytes fed */
	uint8_t buf[64];
	size_t buflen;
};

void sha256_init(struct sha256_ctx *ctx);
void sha256_update(struct sha256_ctx *ctx, const void *data, size_t len);
void sha256_final(struct sha256_ctx *ctx, uint8_t out[SHA256_DIGEST_SIZE]);

/* digest -> lowercase hex string, out must be >= 2*SHA256_DIGEST_SIZE+1 */
void sha256_hex(const uint8_t digest[SHA256_DIGEST_SIZE], char *out);

#endif /* OTA_SHA256_H */
```

## src/eth_phy_reset.c
```c
#include <zephyr/kernel.h>
#include <zephyr/init.h>
#include <zephyr/drivers/gpio.h>
#include <zephyr/drivers/mdio.h>
#include <zephyr/net/mii.h>

#define PHY_RESET_NODE DT_NODELABEL(phy_reset_pin)
static const struct gpio_dt_spec phy_reset =
    GPIO_DT_SPEC_GET(PHY_RESET_NODE, gpios);

static int eth_phy_early_reset(void)
{
    int ret;

    const struct device *mdio_dev = DEVICE_DT_GET(DT_NODELABEL(mdio));
    const struct device *eth_dev = DEVICE_DT_GET(DT_NODELABEL(mac));
#if 0
    if (!gpio_is_ready_dt(&phy_reset)) {
        printk("[ETH_RESET] ERROR: PHY reset GPIO not ready\n");
        return -ENODEV;
    }
    k_msleep(2000);
    printk("[ETH_RESET] Configuring reset pin (PD3)...\n");
    /* GPIO_OUTPUT_INACTIVE： inactive=逻辑0 → 物理高，默认不复位 */
    ret = gpio_pin_configure_dt(&phy_reset, GPIO_OUTPUT_INACTIVE );
    if (ret < 0) {
        printk("[ETH_RESET] ERROR: Failed to configure GPIO: %d\n", ret);
        return ret;
    }

    k_msleep(20);
    int pin_val = gpio_pin_get_dt(&phy_reset);
    printk("[ETH_RESET] Get pin logic level: %d\n", pin_val);

    //配置为输入
    ret = gpio_pin_configure_dt(&phy_reset, GPIO_DISCONNECTED);
    if(ret < 0){
        printk("[ETH_RESET] ERROR: Failed to configure GPIO: %d\n", ret);
        return ret;
    }
    printk("[ETH_RESET] config to input...\n");
    pin_val = gpio_pin_get_dt(&phy_reset);
    printk("[ETH_RESET] Get pin logic level: %d\n", pin_val);
#endif
    printk("[ETH_RESET] Waiting for PHY PLL & 50MHz REF_CLK (2000ms)...\n");
    k_msleep(2000);
    printk("[ETH_RESET] YT8512C PHY reset completed\n");

    ret = device_init(mdio_dev);
    printk("[ETH_RESET] MDIO device_init ret: %d\n", ret);


    /* 手动初始化ETH MAC */
    ret = device_init(eth_dev);
    printk("[ETH_RESET] ETH MAC device_init ret: %d\n", ret);
    return 0;
}
/* 优先级 50 < CONFIG_ETH_INIT_PRIORITY=60 */
SYS_INIT(eth_phy_early_reset, POST_KERNEL, 50);
```

## src/flash_rw.c
```c
/*
 * MCUboot RAM_LOAD OTA over TCP.
 *
 * Protocol (client -> server):
 *   [4 bytes big-endian]  total length of the signed image
 *   [32 bytes]            expected SHA-256 of the whole signed image
 *   [N bytes]             signed image (zephyr.signed.bin)
 *
 * Server replies with a single line: "OK <sha256>\n" or "ERR <reason>\n".
 * On success the device reboots and MCUboot picks the newer image.
 *
 * SPDX-License-Identifier: Apache-2.0
 */

#include <zephyr/kernel.h>
#include <zephyr/logging/log.h>
#include <zephyr/storage/flash_map.h>
#include <zephyr/drivers/flash.h>
#include <zephyr/sys/reboot.h>
#include <zephyr/sys/util.h>
#include <zephyr/sys/byteorder.h>
#include <zephyr/net/socket.h>

#include <errno.h>
#include <stdio.h>
#include <string.h>

#include "sha256.h"

LOG_MODULE_REGISTER(ota, LOG_LEVEL_INF);

#define OTA_PORT         14500
#define OTA_STACK_SIZE   4096
#define OTA_PRIO         7
#define OTA_ACCEPT_TO_MS 2000

#define OTA_WBUF_SIZE    1024
#define OTA_RX_SIZE      1460

/* MCUboot image header, little endian, 32 bytes (see MCUboot docs/design.md) */
#define IMAGE_MAGIC 0x96f3b83dU

struct mcuboot_hdr {
	uint32_t magic;
	uint32_t load_addr;
	uint16_t hdr_size;
	uint16_t prot_tlv_size;
	uint32_t img_size;
	uint32_t flags;
	uint8_t ver_major;
	uint8_t ver_minor;
	uint16_t ver_revision;
	uint32_t ver_build;
	uint32_t pad;
} __packed;

/* ------------------------------------------------------------------ */
/* helpers                                                             */
/* ------------------------------------------------------------------ */

static int recv_exact(int fd, uint8_t *buf, size_t len)
{
	size_t got = 0;

	while (got < len) {
		int n = zsock_recv(fd, buf + got, len - got, 0);

		if (n < 0) {
			return -errno;
		}
		if (n == 0) {
			return -ECONNRESET;	/* peer closed early */
		}
		got += (size_t)n;
	}
	return 0;
}

static int send_line(int fd, const char *s)
{
	size_t len = strlen(s);
	size_t sent = 0;

	while (sent < len) {
		int n = zsock_send(fd, s + sent, len - sent, 0);

		if (n < 0) {
			return -errno;
		}
		sent += (size_t)n;
	}
	return 0;
}

/* Erase the slot lazily, one sector at a time, up to (but not past) 'end' */
static int ensure_erased(const struct flash_area *fa, off_t end,
			 off_t *erased_end, size_t sector)
{
	while (*erased_end < end) {
		int rc = flash_area_erase(fa, *erased_end, sector);

		if (rc != 0) {
			LOG_ERR("erase @0x%lx failed: %d", (long)*erased_end, rc);
			return rc;
		}
		*erased_end += sector;
	}
	return 0;
}

/* ------------------------------------------------------------------ */
/* one OTA session                                                     */
/* ------------------------------------------------------------------ */

static int ota_session(int cli)
{
	const struct flash_area *fa = NULL;
	struct flash_pages_info pi;
	struct sha256_ctx sha;
	static uint8_t rx[OTA_RX_SIZE];
	static uint8_t wbuf[OTA_WBUF_SIZE];
	uint8_t expect[SHA256_DIGEST_SIZE];
	uint8_t calc[SHA256_DIGEST_SIZE];
	uint8_t lenbuf[4];
	uint8_t hdrbuf[sizeof(struct mcuboot_hdr)];
	char hex[2 * SHA256_DIGEST_SIZE + 1];
	char line[96];
	struct mcuboot_hdr new_hdr;
	off_t off = 0;
	off_t erased_end = 0;
	size_t sector;
	size_t wbs;
	size_t wlen = 0;
	uint32_t total;
	uint32_t remaining;
	int rc;

	/* ---- 1. header of the transfer ---- */
	rc = recv_exact(cli, lenbuf, sizeof(lenbuf));
	if (rc != 0) {
		send_line(cli, "ERR recv length\n");
		return rc;
	}
	total = ((uint32_t)lenbuf[0] << 24) | ((uint32_t)lenbuf[1] << 16) |
		((uint32_t)lenbuf[2] << 8) | (uint32_t)lenbuf[3];

	rc = recv_exact(cli, expect, sizeof(expect));
	if (rc != 0) {
		send_line(cli, "ERR recv sha256\n");
		return rc;
	}

	sha256_hex(expect, hex);
	LOG_INF("OTA request: %u bytes, expect sha256=%s", (unsigned)total, hex);

	rc = flash_area_open(FIXED_PARTITION_ID(slot1_partition), &fa);
	if (rc != 0) {
		LOG_ERR("flash_area_open(slot1) failed: %d", rc);
		send_line(cli, "ERR open slot1\n");
		return rc;
	}

	if (total == 0 || total > fa->fa_size) {
		LOG_ERR("bad image size %u (slot is %zu)", (unsigned)total, fa->fa_size);
		send_line(cli, "ERR bad size\n");
		flash_area_close(fa);
		return -EINVAL;
	}

	/* erase granularity = page size at the beginning of the slot */
	rc = flash_get_page_info_by_offs(fa->fa_dev, fa->fa_off, &pi);
	if (rc != 0 || pi.size == 0) {
		LOG_WRN("page info unavailable (%d), assuming 4K sectors", rc);
		sector = 4096;
	} else {
		sector = pi.size;
	}

	wbs = flash_get_write_block_size(fa->fa_dev);
	if (wbs == 0) {
		wbs = 1;
	}

	LOG_INF("slot1: dev_off=0x%lx size=%zu sector=%zu write_block=%zu",
		(long)fa->fa_off, fa->fa_size, sector, wbs);

	/* ---- 2. receive, hash and write ---- */
	sha256_init(&sha);
	remaining = total;

	while (remaining > 0) {
		int n = zsock_recv(cli, rx, MIN((size_t)remaining, sizeof(rx)), 0);

		if (n < 0) {
			LOG_ERR("recv failed: %d", -errno);
			send_line(cli, "ERR recv data\n");
			flash_area_close(fa);
			return -errno;
		}
		if (n == 0) {
			LOG_ERR("peer closed, %u bytes missing", (unsigned)remaining);
			send_line(cli, "ERR truncated\n");
			flash_area_close(fa);
			return -ECONNRESET;
		}

		remaining -= (uint32_t)n;
		sha256_update(&sha, rx, (size_t)n);

		/* buffer -> flash, always in full 1K chunks */
		{
			const uint8_t *p = rx;
			size_t left = (size_t)n;

			while (left > 0) {
				size_t take = MIN(left, sizeof(wbuf) - wlen);

				memcpy(wbuf + wlen, p, take);
				wlen += take;
				p += take;
				left -= take;

				if (wlen == sizeof(wbuf)) {
					rc = ensure_erased(fa, off + wlen, &erased_end, sector);
					if (rc != 0) {
						send_line(cli, "ERR erase\n");
						flash_area_close(fa);
						return rc;
					}
					rc = flash_area_write(fa, off, wbuf, wlen);
					if (rc != 0) {
						LOG_ERR("write @0x%lx failed: %d", (long)off, rc);
						send_line(cli, "ERR write\n");
						flash_area_close(fa);
						return rc;
					}
					off += wlen;
					wlen = 0;
				}
			}
		}
	}

	/* flush the tail: pad with 0xff up to a write-block multiple (NOR flash) */
	if (wlen != 0) {
		size_t rem = wlen % wbs;

		if (rem != 0) {
			memset(wbuf + wlen, 0xff, wbs - rem);
			wlen += wbs - rem;
		}
		rc = ensure_erased(fa, off + wlen, &erased_end, sector);
		if (rc != 0) {
			send_line(cli, "ERR erase\n");
			flash_area_close(fa);
			return rc;
		}
		rc = flash_area_write(fa, off, wbuf, wlen);
		if (rc != 0) {
			LOG_ERR("write @0x%lx failed: %d", (long)off, rc);
			send_line(cli, "ERR write\n");
			flash_area_close(fa);
			return rc;
		}
		off += wlen;
		wlen = 0;
	}

	sha256_final(&sha, calc);
	sha256_hex(calc, hex);
	LOG_INF("written %lu bytes, sha256=%s", (unsigned long)off, hex);

	/* ---- 3. verify ---- */
	if (memcmp(calc, expect, SHA256_DIGEST_SIZE) != 0) {
		sha256_hex(expect, hex);
		LOG_ERR("sha256 mismatch, expected %s", hex);
		send_line(cli, "ERR sha256 mismatch\n");
		flash_area_close(fa);
		return -EBADMSG;
	}
	LOG_INF("sha256 OK");

	/* read the MCUboot header back from flash and sanity check it */
	rc = flash_area_read(fa, 0, hdrbuf, sizeof(hdrbuf));
	if (rc != 0) {
		LOG_ERR("read back header failed: %d", rc);
		send_line(cli, "ERR readback\n");
		flash_area_close(fa);
		return rc;
	}
	memcpy(&new_hdr, hdrbuf, sizeof(new_hdr));

	if (new_hdr.magic != IMAGE_MAGIC) {
		LOG_ERR("bad image magic 0x%08x", (unsigned)new_hdr.magic);
		send_line(cli, "ERR bad magic\n");
		flash_area_close(fa);
		return -EBADMSG;
	}

	LOG_INF("new image: v%u.%u.%u+%u, load_addr=0x%08x, img_size=%u, hdr_size=%u",
		new_hdr.ver_major, new_hdr.ver_minor, new_hdr.ver_revision,
		(unsigned)new_hdr.ver_build, (unsigned)new_hdr.load_addr,
		(unsigned)new_hdr.img_size, (unsigned)new_hdr.hdr_size);

	if (new_hdr.hdr_size + new_hdr.img_size > total) {
		LOG_ERR("header %u + payload %u exceeds %u",
			(unsigned)new_hdr.hdr_size, (unsigned)new_hdr.img_size,
			(unsigned)total);
		send_line(cli, "ERR bad img_size\n");
		flash_area_close(fa);
		return -EBADMSG;
	}

	/* RAM_LOAD picks the image with the higher version: warn if not newer */
	{
		const struct flash_area *fa0 = NULL;

		rc = flash_area_open(FIXED_PARTITION_ID(slot0_partition), &fa0);
		if (rc == 0) {
			struct mcuboot_hdr cur;

			rc = flash_area_read(fa0, 0, hdrbuf, sizeof(hdrbuf));
			if (rc == 0) {
				memcpy(&cur, hdrbuf, sizeof(cur));
				if (cur.magic == IMAGE_MAGIC) {
					uint32_t new_v = ((uint32_t)new_hdr.ver_major << 16) |
							 ((uint32_t)new_hdr.ver_minor << 8) |
							 new_hdr.ver_revision;
					uint32_t cur_v = ((uint32_t)cur.ver_major << 16) |
							 ((uint32_t)cur.ver_minor << 8) |
							 cur.ver_revision;

					LOG_INF("slot0 image: v%u.%u.%u+%u", cur.ver_major,
						cur.ver_minor, cur.ver_revision,
						(unsigned)cur.ver_build);
					if (new_v <= cur_v) {
						LOG_WRN("new image version is not higher "
							"-> RAM_LOAD will keep booting slot0");
					}
				}
			}
			flash_area_close(fa0);
		}
	}

	flash_area_close(fa);

	/* ---- 4. done ---- */
	snprintf(line, sizeof(line), "OK %s\n", hex);
	send_line(cli, line);

	LOG_INF("OTA success, rebooting in 500 ms ...");
	k_msleep(500);

	/* MCUboot validates the signature and copies the newer image to RAM */
	sys_reboot(SYS_REBOOT_COLD);

	return 0;
}

/* ------------------------------------------------------------------ */
/* TCP server thread                                                   */
/* ------------------------------------------------------------------ */

static void ota_thread(void *p1, void *p2, void *p3)
{
	struct sockaddr_in addr;
	struct zsock_timeval tv;
	int srv;
	int rc;
	int opt;

	ARG_UNUSED(p1);
	ARG_UNUSED(p2);
	ARG_UNUSED(p3);

	/* give the network stack some time to come up */
	k_msleep(3000);

	srv = zsock_socket(AF_INET, SOCK_STREAM, IPPROTO_TCP);
	if (srv < 0) {
		LOG_ERR("socket() failed: %d", errno);
		return;
	}

	opt = 1;
	zsock_setsockopt(srv, SOL_SOCKET, SO_REUSEADDR, &opt, sizeof(opt));

	memset(&addr, 0, sizeof(addr));
	addr.sin_family = AF_INET;
	addr.sin_port = sys_cpu_to_be16(OTA_PORT);
	addr.sin_addr.s_addr = 0;	/* INADDR_ANY */

	rc = zsock_bind(srv, (const struct sockaddr *)&addr, sizeof(addr));
	if (rc < 0) {
		LOG_ERR("bind() failed: %d", errno);
		zsock_close(srv);
		return;
	}

	rc = zsock_listen(srv, 1);
	if (rc < 0) {
		LOG_ERR("listen() failed: %d", errno);
		zsock_close(srv);
		return;
	}

	LOG_INF("OTA server listening on TCP port %u", OTA_PORT);

	while (1) {
		int cli = zsock_accept(srv, NULL, NULL);

		if (cli < 0) {
			LOG_DBG("accept() failed: %d", errno);
			k_msleep(OTA_ACCEPT_TO_MS);
			continue;
		}

		/* do not hang forever on a dead peer */
		tv.tv_sec = 30;
		tv.tv_usec = 0;
		zsock_setsockopt(cli, SOL_SOCKET, SO_RCVTIMEO, &tv, sizeof(tv));
		zsock_setsockopt(cli, SOL_SOCKET, SO_SNDTIMEO, &tv, sizeof(tv));

		ota_session(cli);

		zsock_close(cli);
	}
}

K_THREAD_DEFINE(ota_tid, OTA_STACK_SIZE, ota_thread, NULL, NULL, NULL,
		OTA_PRIO, 0, 0);
```

## src/sha256.c
```c
/*
 * Minimal self-contained SHA-256 implementation.
 * SPDX-License-Identifier: Apache-2.0
 */

#include <string.h>
#include "sha256.h"

static const uint32_t sha256_k[64] = {
	0x428a2f98, 0x71374491, 0xb5c0fbcf, 0xe9b5dba5,
	0x3956c25b, 0x59f111f1, 0x923f82a4, 0xab1c5ed5,
	0xd807aa98, 0x12835b01, 0x243185be, 0x550c7dc3,
	0x72be5d74, 0x80deb1fe, 0x9bdc06a7, 0xc19bf174,
	0xe49b69c1, 0xefbe4786, 0x0fc19dc6, 0x240ca1cc,
	0x2de92c6f, 0x4a7484aa, 0x5cb0a9dc, 0x76f988da,
	0x983e5152, 0xa831c66d, 0xb00327c8, 0xbf597fc7,
	0xc6e00bf3, 0xd5a79147, 0x06ca6351, 0x14292967,
	0x27b70a85, 0x2e1b2138, 0x4d2c6dfc, 0x53380d13,
	0x650a7354, 0x766a0abb, 0x81c2c92e, 0x92722c85,
	0xa2bfe8a1, 0xa81a664b, 0xc24b8b70, 0xc76c51a3,
	0xd192e819, 0xd6990624, 0xf40e3585, 0x106aa070,
	0x19a4c116, 0x1e376c08, 0x2748774c, 0x34b0bcb5,
	0x391c0cb3, 0x4ed8aa4a, 0x5b9cca4f, 0x682e6ff3,
	0x748f82ee, 0x78a5636f, 0x84c87814, 0x8cc70208,
	0x90befffa, 0xa4506ceb, 0xbef9a3f7, 0xc67178f2
};

#define ROR32(x, n) (((x) >> (n)) | ((x) << (32 - (n))))

static uint32_t be32(const uint8_t *p)
{
	return ((uint32_t)p[0] << 24) | ((uint32_t)p[1] << 16) |
	       ((uint32_t)p[2] << 8) | (uint32_t)p[3];
}

static void put_be32(uint8_t *p, uint32_t v)
{
	p[0] = (uint8_t)(v >> 24);
	p[1] = (uint8_t)(v >> 16);
	p[2] = (uint8_t)(v >> 8);
	p[3] = (uint8_t)v;
}

static void sha256_compress(struct sha256_ctx *ctx, const uint8_t block[64])
{
	uint32_t w[64];
	uint32_t a, b, c, d, e, f, g, h;
	int i;

	for (i = 0; i < 16; i++) {
		w[i] = be32(block + 4 * i);
	}
	for (i = 16; i < 64; i++) {
		uint32_t s0 = ROR32(w[i - 15], 7) ^ ROR32(w[i - 15], 18) ^ (w[i - 15] >> 3);
		uint32_t s1 = ROR32(w[i - 2], 17) ^ ROR32(w[i - 2], 19) ^ (w[i - 2] >> 10);

		w[i] = w[i - 16] + s0 + w[i - 7] + s1;
	}

	a = ctx->state[0];
	b = ctx->state[1];
	c = ctx->state[2];
	d = ctx->state[3];
	e = ctx->state[4];
	f = ctx->state[5];
	g = ctx->state[6];
	h = ctx->state[7];

	for (i = 0; i < 64; i++) {
		uint32_t s1 = ROR32(e, 6) ^ ROR32(e, 11) ^ ROR32(e, 25);
		uint32_t ch = (e & f) ^ (~e & g);
		uint32_t t1 = h + s1 + ch + sha256_k[i] + w[i];
		uint32_t s0 = ROR32(a, 2) ^ ROR32(a, 13) ^ ROR32(a, 22);
		uint32_t maj = (a & b) ^ (a & c) ^ (b & c);
		uint32_t t2 = s0 + maj;

		h = g;
		g = f;
		f = e;
		e = d + t1;
		d = c;
		c = b;
		b = a;
		a = t1 + t2;
	}

	ctx->state[0] += a;
	ctx->state[1] += b;
	ctx->state[2] += c;
	ctx->state[3] += d;
	ctx->state[4] += e;
	ctx->state[5] += f;
	ctx->state[6] += g;
	ctx->state[7] += h;
}

void sha256_init(struct sha256_ctx *ctx)
{
	ctx->state[0] = 0x6a09e667;
	ctx->state[1] = 0xbb67ae85;
	ctx->state[2] = 0x3c6ef372;
	ctx->state[3] = 0xa54ff53a;
	ctx->state[4] = 0x510e527f;
	ctx->state[5] = 0x9b05688c;
	ctx->state[6] = 0x1f83d9ab;
	ctx->state[7] = 0x5be0cd19;
	ctx->count = 0;
	ctx->buflen = 0;
	memset(ctx->buf, 0, sizeof(ctx->buf));
}

void sha256_update(struct sha256_ctx *ctx, const void *data, size_t len)
{
	const uint8_t *p = data;

	ctx->count += len;

	/* Fill the pending partial block first */
	if (ctx->buflen != 0) {
		size_t n = 64 - ctx->buflen;

		if (n > len) {
			n = len;
		}
		memcpy(ctx->buf + ctx->buflen, p, n);
		ctx->buflen += n;
		p += n;
		len -= n;

		if (ctx->buflen == 64) {
			sha256_compress(ctx, ctx->buf);
			ctx->buflen = 0;
		}
	}

	while (len >= 64) {
		sha256_compress(ctx, p);
		p += 64;
		len -= 64;
	}

	if (len != 0) {
		memcpy(ctx->buf + ctx->buflen, p, len);
		ctx->buflen += len;
	}
}

void sha256_final(struct sha256_ctx *ctx, uint8_t out[SHA256_DIGEST_SIZE])
{
	uint64_t bits = ctx->count * 8U;
	uint8_t tail[64 + 8];
	size_t tail_len;
	size_t pad_len;
	int i;

	/* 0x80, then zeros until length % 64 == 56 */
	memcpy(tail, ctx->buf, ctx->buflen);
	tail[ctx->buflen] = 0x80;
	tail_len = ctx->buflen + 1;
	pad_len = (64 - ((tail_len + 8U) % 64U)) % 64U;
	memset(tail + tail_len, 0, pad_len);
	tail_len += pad_len;

	put_be32(tail + tail_len, (uint32_t)(bits >> 32));
	put_be32(tail + tail_len + 4, (uint32_t)bits);
	tail_len += 8;

	for (i = 0; (size_t)i < tail_len; i += 64) {
		sha256_compress(ctx, tail + i);
	}

	for (i = 0; i < 8; i++) {
		put_be32(out + 4 * i, ctx->state[i]);
	}
}

void sha256_hex(const uint8_t digest[SHA256_DIGEST_SIZE], char *out)
{
	static const char hex[] = "0123456789abcdef";
	int i;

	for (i = 0; i < SHA256_DIGEST_SIZE; i++) {
		out[2 * i] = hex[digest[i] >> 4];
		out[2 * i + 1] = hex[digest[i] & 0x0f];
	}
	out[2 * SHA256_DIGEST_SIZE] = '\0';
}
```

## src/shell_led_cmd.c
```c
#include <zephyr/shell/shell.h>
#include <zephyr/logging/log.h>
#include <zephyr/kernel.h>
#include <stdlib.h>
#include <zephyr/drivers/gpio.h>

#define LED0_NODE DT_ALIAS(led1)
static const struct gpio_dt_spec led = GPIO_DT_SPEC_GET(LED0_NODE, gpios);


LOG_MODULE_REGISTER(led_shell,LOG_LEVEL_INF);

static int cmd_led_on(const struct shell *sh, size_t argc, char **argv)
{
    ARG_UNUSED(argc);
    ARG_UNUSED(argv);
    if(!gpio_is_ready_dt(&led)){
        shell_print(sh,"gpio is not ready!");
        return -1;
    }
    int ret = gpio_pin_configure_dt(&led,GPIO_OUTPUT_ACTIVE);
    if(ret < 0){
        shell_print(sh,"Failed to configure LED");
        return ret;
    }
    ret = gpio_pin_set_dt(&led, 1);
    if(ret < 0){
        shell_print(sh,"Failed to set gpio!");
    }


    shell_print(sh,"Turn led on!");
    return 0;
}

static int cmd_led_off(const struct shell *sh, size_t argc, char **argv)
{
    ARG_UNUSED(argc);
    ARG_UNUSED(argv);
    if(!gpio_is_ready_dt(&led)){
        shell_print(sh,"gpio is not ready!");
        return -1;
    }
    int ret = gpio_pin_configure_dt(&led,GPIO_OUTPUT_ACTIVE);
    if(ret < 0){
        shell_print(sh,"Failed to configure LED");
        return ret;
    }
    ret = gpio_pin_set_dt(&led, 0);
    if(ret < 0){
        shell_print(sh,"Failed to set gpio!");
    }

    shell_print(sh,"Turn led off!");

    return 0;
}

static int cmd_led_set(const struct shell *sh, size_t argc, char **argv)
{
    if (argc != 2) {
        shell_error(sh, "Usage: led set <0/1>");
        return -EINVAL;
    }
    if(!gpio_is_ready_dt(&led)){
        shell_print(sh,"gpio is not ready!");
        return -1;
    }
    int ret = gpio_pin_configure_dt(&led,GPIO_OUTPUT_ACTIVE);
    if(ret < 0){
        shell_print(sh,"Failed to configure LED");
        return ret;
    }
    int level = atoi(argv[1]);
    ret = gpio_pin_set_dt(&led, level);
    if(ret < 0){
        shell_print(sh,"Failed to set gpio!");
    }
    shell_print(sh,"Set led!");

    return 0;
}

SHELL_STATIC_SUBCMD_SET_CREATE(sub_led,
        SHELL_CMD(on,NULL,"turn led on",cmd_led_on),
        SHELL_CMD(off,NULL,"turn led off",cmd_led_off),
        SHELL_CMD(set,NULL,"turn led on/off",cmd_led_set),
        SHELL_SUBCMD_SET_END
);

SHELL_CMD_REGISTER(led,&sub_led,"led controller",NULL);
```

## src/shell_littlefs_cmd.c
```c
#include <zephyr/fs/fs.h>
#include <zephyr/fs/littlefs.h>
#include <zephyr/storage/flash_map.h>
#include <zephyr/logging/log.h>
#include <zephyr/shell/shell.h>
LOG_MODULE_REGISTER(littlefs_cmd, LOG_LEVEL_INF);

// 定义挂载点
FS_LITTLEFS_DECLARE_DEFAULT_CONFIG(littlefs);
static struct fs_mount_t lfs_mnt = {
    .type = FS_LITTLEFS,
    .fs_data = &littlefs,
    .storage_dev = (void *)FIXED_PARTITION_ID(littlefs_partition),
    .mnt_point = "/lfs",
};


int cmd_mount(const struct shell *shell, size_t argc, char **argv)
{
    int rc = fs_mount(&lfs_mnt);
    if (rc != 0) {
        shell_error(shell, "Failed to mount filesystem: %d", rc);
        return -ENOEXEC;
    }
    shell_print(shell, "Filesystem mounted at %s", lfs_mnt.mnt_point);
    return 0;
}

int cmd_open_write(const struct shell *shell, size_t argc, char **argv)
{ 
    struct fs_file_t file;
    int rc;

    // 初始化文件结构
    fs_file_t_init(&file);

    char filename[64];
    sprintf(filename, "/lfs/%s", argv[1]);

    // 打开文件（创建或覆盖）
    rc = fs_open(&file, filename, FS_O_CREATE | FS_O_WRITE);
    if (rc != 0) {
        LOG_ERR("Failed to open file: %d", rc);
        return -1;
    }
    char buf[64];
    sprintf(buf, "%s", argv[2]);
    rc = fs_write(&file, buf, strlen(buf));
    if (rc < 0) {
        LOG_ERR("Failed to write file: %d", rc);
        fs_close(&file);
        return -1;
    }
    LOG_INF("Wrote %d bytes", rc);
    fs_close(&file);
}
int cmd_open_read(const struct shell *shell, size_t argc, char **argv)
{ 
    struct fs_file_t file;
    int rc;

    // 初始化文件结构
    fs_file_t_init(&file);

    char filename[64];
    sprintf(filename, "/lfs/%s", argv[1]);

    // 打开文件（创建或覆盖）
    rc = fs_open(&file, filename, FS_O_READ);
    if (rc != 0) {
        LOG_ERR("Failed to open file: %d", rc);
        return -1;
    }
    char read_buf[64];
    rc = fs_read(&file, read_buf, sizeof(read_buf) - 1);
    if (rc < 0) {
        LOG_ERR("Failed to read file: %d", rc);
        fs_close(&file);
        return -1;
    }
    read_buf[rc] = '\0';
    LOG_INF("Read: %s", read_buf);
    fs_close(&file);
}
int cmd_umount(const struct shell *shell, size_t argc, char **argv)
{
    // 检查挂载状态
    if (lfs_mnt.mnt_point == NULL) {
        shell_print(shell, "Filesystem not mounted");
        return 0;
    }
    
    int rc = fs_unmount(&lfs_mnt);
    if (rc != 0) {
        shell_error(shell, "Failed to umount filesystem: %d", rc);
        return -ENOEXEC;
    }
    shell_print(shell, "Filesystem unmounted");
    return 0;
}
SHELL_STATIC_SUBCMD_SET_CREATE(sub_lfs,
        SHELL_CMD(mount,NULL,"mount littlefs",cmd_mount),
        SHELL_CMD(open_write,NULL,"open file in littlefs",cmd_open_write),
        SHELL_CMD(open_read,NULL,"open file in littlefs",cmd_open_read),
        SHELL_CMD(umount,NULL,"umount littlefs",cmd_umount),
        SHELL_SUBCMD_SET_END
);

SHELL_CMD_REGISTER(lfs_cmd,&sub_lfs,"littlefs controller",NULL);
```

## src/shell_pwm_led_cmd.c
```c
#include <zephyr/shell/shell.h>
#include <zephyr/logging/log.h>
#include <zephyr/kernel.h>
#include <zephyr/devicetree.h>
#include <zephyr/drivers/gpio.h>
#include <zephyr/drivers/pwm.h>
#include <zephyr/drivers/led.h>
#include <zephyr/sys/util.h>
#include <stdlib.h>

#define LED_PWM_NODE_ID DT_COMPAT_GET_ANY_STATUS_OKAY(pwm_leds)

static const struct device *led_pwm = DEVICE_DT_GET(LED_PWM_NODE_ID);

static int cmd_pwm_led_on(const struct shell *shell, size_t argc, char **argv)
{
    UNUSED(argc);
    UNUSED(argv);
    if(!device_is_ready(led_pwm)) {
        shell_print(shell,"LED PWM device is not ready");
        return 0;
    } 

    int err = led_on(led_pwm,0);
    if(err) {
        shell_print(shell,"Error turning on LED PWM device");
        return 0;
    }
    shell_print(shell,"LED PWM device turned on");
}

static int cmd_pwm_led_set_brightness(const struct shell *shell, size_t argc, char **argv)
{
    UNUSED(argc);
    if(!device_is_ready(led_pwm)) {
        shell_print(shell,"LED PWM device is not ready");
        return 0;
    } 
    int err = led_set_brightness(led_pwm,0,atoi(argv[1]));
    if(err) {
        shell_print(shell,"Error setting brightness");
        return 0;
    }
    shell_print(shell,"Brightness set to %d",atoi(argv[1]));
}

static int cmd_pwm_led_off(const struct shell *shell, size_t argc, char **argv)
{
    UNUSED(argc);
    UNUSED(argv);
    if(!device_is_ready(led_pwm)) {
        shell_print(shell,"LED PWM device is not ready");
        return 0;
    } 
    int err = led_off(led_pwm,0);
    if(err) {
        shell_print(shell,"Error turning off LED PWM device");
        return 0;
    }
    shell_print(shell,"LED PWM device turned off");
}
SHELL_STATIC_SUBCMD_SET_CREATE(sub_pwm_led,
        SHELL_CMD(on,NULL,"turn led on",cmd_pwm_led_on),
        SHELL_CMD(off,NULL,"turn led off",cmd_pwm_led_off),
        SHELL_CMD(set_brightness,NULL,"set led brightness",cmd_pwm_led_set_brightness),
        
        SHELL_SUBCMD_SET_END
);

SHELL_CMD_REGISTER(pwm_led,&sub_pwm_led,"pwm led controller",NULL);
```

## src/shell_sensor_cmd.c
```c
#include <zephyr/shell/shell.h>
#include <zephyr/kernel.h>
#include <zephyr/device.h>
#include <zephyr/devicetree.h>
#include <zephyr/drivers/sensor.h>

/*
 * Get a device structure from a devicetree node with compatible
 * "maxim,ds18b20". (If there are multiple, just pick one.)
 */
static const struct device *get_ds18b20_device(void)
{
	const struct device *const dev = DEVICE_DT_GET_ANY(maxim_ds18b20);

	if (dev == NULL) {
		/* No such node, or the node does not have status "okay". */
		printk("\nError: no device found.\n");
		return NULL;
	}

	if (!device_is_ready(dev)) {
		printk("\nError: Device \"%s\" is not ready; "
		       "check the driver initialization logs for errors.\n",
		       dev->name);
		return NULL;
	}

	printk("Found device \"%s\", getting sensor data\n", dev->name);
	return dev;
}

static int cmd_read_temp(const struct shell *shell, size_t argc, char **argv)
{
	const struct device *dev = get_ds18b20_device();
	int res;

	if (dev == NULL) {
		return 0;
	}

    struct sensor_value temp;

    res = sensor_sample_fetch(dev);
    if (res != 0) {
        shell_print(shell,"sample_fetch() failed: %d\n", res);
        return res;
    }

    res = sensor_channel_get(dev, SENSOR_CHAN_AMBIENT_TEMP, &temp);
    if (res != 0) {
        shell_print(shell,"channel_get() failed: %d\n", res);
        return res;
    }

    shell_print(shell,"Temp: %d.%06d\n", temp.val1, temp.val2);

	

	return 0;
}
SHELL_STATIC_SUBCMD_SET_CREATE(sub_sensor,
        SHELL_CMD(read_temp,NULL,"read temperature from sensor",cmd_read_temp),
      
        SHELL_SUBCMD_SET_END
);

SHELL_CMD_REGISTER(sensor,&sub_sensor,"sensor controller",NULL);
```

## src/shell_uart_cmd.c
```c
#include <zephyr/shell/shell.h>
#include <zephyr/kernel.h>
#include <zephyr/drivers/uart.h>
#include <zephyr/usb/usb_device.h>
#include <zephyr/sys/ring_buffer.h>



extern const struct device *uart;


#define RX_BUF_SIZE 64

RING_BUF_DECLARE(uart_ringbuf, 64); 

static struct k_work uart_rx_work;


static struct k_work_q uart_work_q;
K_THREAD_STACK_DEFINE(uart_work_q_stack, 2048);
#define CDC_ACM_DEV DEVICE_DT_GET(DT_NODELABEL(cdc_acm_uart0))

static void uart_rx_work_handler(struct k_work *work)
{
    uint8_t buf[32];
    uint32_t len;

    /* 从环形缓冲区中取出数据 */
    while ((len = ring_buf_get(&uart_ringbuf, buf, sizeof(buf))) > 0) {
        printk("Received %d bytes: ", len);
        for (uint32_t i = 0; i < len; i++) {
            printk("%02x ", buf[i]);
        }
        printk("\n");
    }
}

static void uart_callback(const struct device *dev, void *user_data)
{
    uint8_t buf[32];
    int recv_len = 0;

    uart_irq_update(dev);
    if (!uart_irq_rx_ready(dev)) 
        return;


    while (uart_fifo_read(dev, &buf[recv_len], 1) == 1 && recv_len < sizeof(buf)) {
        recv_len++;
    }

    if (recv_len > 0) {
        /* ring_buf_put 是线程和中断安全的 */
        ring_buf_put(&uart_ringbuf, buf, recv_len);
        k_work_submit_to_queue(&uart_work_q, &uart_rx_work);
    }
}
static void cmd_uart_init(void)
{
    if(!device_is_ready(CDC_ACM_DEV)){
        printk("CDC ACM device is not ready\n");
        return;
    }
    usb_enable(NULL);
    k_work_queue_init(&uart_work_q);
    k_work_queue_start(&uart_work_q, uart_work_q_stack,
                   K_THREAD_STACK_SIZEOF(uart_work_q_stack),
                   5, NULL);

    k_work_init(&uart_rx_work, uart_rx_work_handler);
    uart_irq_callback_user_data_set(CDC_ACM_DEV, uart_callback, NULL);
    uart_irq_rx_enable(CDC_ACM_DEV);

}

static int cmd_uart_send(const struct shell *sh, size_t argc, char **argv)
{
    if (argc < 2) {
        shell_print(sh, "Usage: uart send <string>");
        return -EINVAL;
    }

    
    for (int i = 0; argv[1][i] != '\0'; i++) {
        uart_poll_out(CDC_ACM_DEV, argv[1][i]);
    }
    uart_poll_out(CDC_ACM_DEV, '\r');
    uart_poll_out(CDC_ACM_DEV, '\n');

    shell_print(sh, "Sent: %s", argv[1]);
    return 0;
}



SHELL_STATIC_SUBCMD_SET_CREATE(sub_uart,
        SHELL_CMD(send,NULL,"send data over uart",cmd_uart_send),
        SHELL_CMD(init,NULL,"initialize uart",cmd_uart_init),
        SHELL_SUBCMD_SET_END
);

SHELL_CMD_REGISTER(uart,&sub_uart,"uart controller",NULL);
```
